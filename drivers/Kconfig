## drivers/Kconfig
```kconfig
menuconfig IPC_SERVICE_BACKEND_UART
    bool "Enable UART based IPC service backend"
    depends on SERIAL && IPC_SERVICE && UART_ASYNC_API

if IPC_SERVICE_BACKEND_UART

module = IPC_BACKEND_UART
module-str = uart ipc service backend driver
source "subsys/logging/Kconfig.template.log_config"

endif
```

## tests/drivers/Kconfig
```kconfig
menu "uart ipc service backend test"

rsource "../../drivers/Kconfig"
endmenu

menu "Zephyr Kernel"
source "Kconfig.zephyr"
endmenu
```
